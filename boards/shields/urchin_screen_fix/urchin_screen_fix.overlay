// dongle_screen 모듈의 xiao_ble_zmk.overlay를 이 하드웨어에 맞게 보정한다.
// 반드시 dongle_screen 뒤에 오도록 실드 목록에 나열해야 한다.

// 이 XIAO의 D9 핀이 불량이라 SPI CS를 D2로 우회한다.
&spi3 {
    cs-gpios = <&xiao_d 2 GPIO_ACTIVE_LOW>;
};

&st7789 {
    // 모듈 기본값은 30MHz. 15cm 듀폰선 + GND 1선 배선이라 8MHz로 둔다.
    // 134KB 전체 화면 갱신이 약 0.13초이고 LVGL은 변경 영역만 다시 그리므로
    // 애니메이션에는 충분하다. 화면이 깨지면 4MHz로 내리고, 배선을 짧게
    // 하거나 GND를 보강했다면 16~30MHz까지 올려볼 수 있다.
    mipi-max-frequency = <8000000>;
};

// 광 센서 미사용. 모듈 오버레이가 int-gpios로 D2를 잡아 CS와 충돌한다.
// status="okay" 노드가 있으면 CONFIG_APDS9960이 자동으로 켜지므로
// .conf로는 막을 수 없고 노드를 여기서 꺼야 한다.
&apds9960 {
    status = "disabled";
};
